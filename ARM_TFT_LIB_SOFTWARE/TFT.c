
#include "TFT.h"



uint8_t FONT[133][8]  =
{
    {0x00,0x00,0x00,0x00,0x00,0x00,0x00,0x00},//, // space 0x20
    {0x30,0x78,0x78,0x30,0x30,0x00,0x30,0x00}, // !
    {0x6C,0x6C,0x6C,0x00,0x00,0x00,0x00,0x00}, // "
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    {0xFF,0x81,0x81,0x81,0x81,0x81,0x81,0xFF}
};



int strlen(const char *str)
{
    const char *s;

    for (s = str; *s; ++s)
        ;
    return (s - str);
}

uint8_t RGB565TORGB323(uint16_t COLOR)
{


    uint8_t B =  (((COLOR) & 0x001F) << 3);
    uint8_t G  = (((COLOR) & 0x07E0) >> 3);
    uint8_t R  = (((COLOR) & 0xF800) >> 8);



    uint8_t k = 0;
    k =  (((R)&0xE0) | ((G>>3)&0x18) | ((B>>5)&0x7));



    return k;
}

uint16_t RGB565(uint8_t R, uint8_t G, uint8_t B)
{
    return (((R>>3)<<11) | ((G>>2)<<5) | (B>>3));
}

uint8_t RGB323(uint8_t R, uint8_t G, uint8_t B)
{
    uint8_t k = 0;
    k =  (((R)&0xE0) | ((G>>3)&0x18) | ((B>>5)&0x7));

    return  k;
}

void TFT_bitmap(void *h2p_lw_addr, uint16_t *img, uint16_t x, uint16_t y)
{
    int i=0;
    for(i=0; i<x*y; i++)
    {
        *(uint8_t *)(h2p_lw_addr+i) = RGB565TORGB323(img[i]);
    }

}

void TFT_text(void *h2p_lw_addr, char* text, uint16_t x, uint16_t y, uint16_t COLOR)
{
    unsigned char length = strlen(text);
    while(length--)
    {
        TFT_char(h2p_lw_addr,*(text++),x,y,COLOR);

        x += 8;
    }
}

void TFT_char(void *h2p_lw_addr,char sign,uint16_t x, uint16_t y, uint16_t COLOR)
{

    uint8_t c = (uint8_t)sign-0x20;
    uint8_t mask=0b10000000;
    uint8_t line;

    uint8_t i;
    uint8_t j;


    for(i=0; i<8; i++)
    {
        line = FONT[c][i];
        mask=0b10000000;

        for(j=0; j<8; j++)
        {
            if(line&mask)
            {
                TFT_setpix(h2p_lw_addr,x+j,y+i,COLOR);
            }
            mask>>=1;
        }

    }

}

void TFT_fill(void *h2p_lw_addr,uint8_t COLOR)
{

    int x=0;
    int y=0;

    for ( x=0; x<Hsize; x++)
    {
        for ( y=0; y<Vsize; y++)
        {
            TFT_setpix(h2p_lw_addr,x,y,COLOR);
        }
    }
}

void TFT_rectangle(void *h2p_lw_addr,uint16_t x1, uint16_t y1, uint16_t x2, uint16_t y2, uint8_t COLOR)
{
    int x=0;
    int y=0;

    for(y = y1; y <= y2; y++)
    {
        for(x = x1; x <= x2; x++)
        {
            TFT_setpix(h2p_lw_addr,x,y,COLOR);
        }
    }
}


void TFT_circle(void *h2p_lw_addr,uint16_t x, uint16_t y, uint16_t rad, uint8_t COLOR)
{
    int x1=0;
    int y1=0;

    for( y1=0; y1<=2*rad; y1++)
    {
        for( x1=0; x1<=2*rad; x1++)
        {
            if (((x1-rad)*(x1-rad)+(y1-rad)*(y1-rad) <= (rad*rad))&&((x1-rad)*(x1-rad)+(y1-rad)*(y1-rad) >= (rad*rad)-3*rad))
            {
                TFT_setpix(h2p_lw_addr,x1+x,y1+y,COLOR);
            }
        }
    }
}

void TFT_rounddd(void *h2p_lw_addr,uint16_t x, uint16_t y, uint16_t rad, uint8_t COLOR)
{
    uint16_t x1=0;
    uint16_t y1=0;

    for(y1=0; y1<=2*rad; y1++)
    {


        for(x1=0; x1<=2*rad; x1++)
        {


            if ((x1-rad)*(x1-rad)+(y1-rad)*(y1-rad) <= (rad*rad))
            {
                TFT_setpix(h2p_lw_addr,x1+x,y1+y,COLOR);
            }
        }
    }
}

void TFT_line(void *h2p_lw_addr,uint16_t x1, uint16_t y1, uint16_t x2, uint16_t y2, uint8_t COLOR)
{

    int dx = abs(x2-x1), sx = x1<x2 ? 1 : -1;
    int dy = abs(y2-y1), sy = y1<y2 ? 1 : -1;
    int err = (dx>dy ? dx : -dy)/2, e2;

    for(;;)
    {
        TFT_setpix(h2p_lw_addr,x1,y1,COLOR);
        if (x1==x2 && y1==y2) break;
        e2 = err;
        if (e2 >-dx)
        {
            err -= dy;
            x1 += sx;
        }
        if (e2 < dy)
        {
            err += dx;
            y1 += sy;
        }
    }
}

void TFT_setpix(void *h2p_lw_addr,unsigned short X, unsigned short Y, uint8_t COLOR)
{
    *(uint8_t *)(h2p_lw_addr + getaddr(X,Y)) = COLOR;
}

int getaddr(unsigned short X, unsigned short Y)
{

    if (X<=Hsize && Y<=Vsize)
        return  ((Y * Hsize)+X);

    return -1;

}
